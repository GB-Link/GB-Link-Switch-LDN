## esp-adapter/adapter/main/Kconfig.projbuild
```kconfig
menu "Bridge link"

config GB_LINK_TX_GPIO
    int "TX, to the bridge board's RX"
    default 17 if IDF_TARGET_ESP32
    default 7 if IDF_TARGET_ESP32S3
    default 19 if IDF_TARGET_ESP32C6
    default 2

config GB_LINK_RX_GPIO
    int "RX, from the bridge board's TX"
    default 16 if IDF_TARGET_ESP32
    default 8 if IDF_TARGET_ESP32S3
    default 20 if IDF_TARGET_ESP32C6
    default 1

endmenu
```

## esp-adapter/components/rfu_adapter/Kconfig
```kconfig
menu "GBA wireless adapter"

config WA_PIN_SC
    int "SC: the link clock (GBA link port pin 5)"
    default 18 if IDF_TARGET_ESP32
    default 5 if IDF_TARGET_ESP32S3
    default 19 if IDF_TARGET_ESP32C6
    default 5

config WA_PIN_SO
    int "SO: the GBA's output (link port pin 2)"
    default 19 if IDF_TARGET_ESP32
    default 6 if IDF_TARGET_ESP32S3
    default 20 if IDF_TARGET_ESP32C6
    default 6

config WA_PIN_SI
    int "SI: the GBA's input (link port pin 3)"
    default 21 if IDF_TARGET_ESP32
    default 7 if IDF_TARGET_ESP32S3
    default 18 if IDF_TARGET_ESP32C6
    default 7

config WA_PIN_SD
    int "SD: the GBA's soft-reset line (link port pin 4)"
    default 22 if IDF_TARGET_ESP32
    default 8 if IDF_TARGET_ESP32S3
    default 21 if IDF_TARGET_ESP32C6
    default 8

config WA_HANDSHAKE_SPIN_US
    int "Microseconds a word's interrupt waits for the GBA's handshake"
    range 2 200
    default 15
    help
        After each command word the GBA raises SO within a few microseconds of seeing
        SI high. Waiting here releases it straight away; past this, an SO interrupt
        does it a little later.

config WA_TASK_PRIORITY
    int "Adapter task priority"
    range 1 24
    default 15

config WA_TASK_CORE
    int "Adapter task core (dual-core chips)"
    range 0 1
    default 1
    help
        The core that runs the adapter task and takes its interrupts. Core 1 keeps
        them away from Wi-Fi on dual-core chips.

endmenu
```
