## firmware/common/Kconfig.projbuild
```kconfig
menu "LDN bridge"
config LDN_PROBE_CHANNEL
    int "Initial 2.4 GHz channel"
    range 1 11
    default 1
config LDN_PROBE_PRIVATE_JOIN
    bool
    default y
config LDN_PROBE_EXPORT_ADVERTISEMENTS
    bool
    default y
config LDN_PROBE_CONTROL_PORT
    bool
    default y
config LDN_PROBE_LEGACY_PHY
    bool "Use 802.11b/g for LDN compatibility"
    default y
config PICO_LINK_TX_GPIO
    int "GPIO wired to the GB-Link's GP9 (its UART RX)"
    default 2
config PICO_LINK_RX_GPIO
    int "GPIO wired to the GB-Link's GP8 (its UART TX)"
    default 1
config PIA_STATIC_ZSTD_CONTEXT
    bool "Reserve the decompression context at link time"
    default y
    help
        40 KB of static data. Turn it off on a chip whose static data region is too small
        (the original ESP32); the context then comes from the heap at the start of boot.
endmenu
```

## firmware/esp32/sdkconfig.defaults
```kconfig
CONFIG_IDF_TARGET="esp32"
CONFIG_ESPTOOLPY_FLASHSIZE_4MB=y
CONFIG_ESPTOOLPY_FLASHMODE_DIO=y
CONFIG_ESPTOOLPY_FLASHFREQ_40M=y
CONFIG_ESP_CONSOLE_UART_DEFAULT=y
CONFIG_LWIP_DHCPS_STATIC_ENTRIES=y
CONFIG_FREERTOS_HZ=1000
```
